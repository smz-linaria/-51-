#include "oled.h"
#include <intrins.h>

// 6x8 ASCII 字库 (已验证)
const unsigned char code F6x8[][6] = {
    {0x00, 0x00, 0x00, 0x00, 0x00, 0x00}, // sp
    {0x00, 0x00, 0x00, 0x2f, 0x00, 0x00}, // !
    {0x00, 0x06, 0x01, 0x86, 0x06, 0x00}, // "
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    {0x61, 0x51, 0x49, 0x45, 0x43, 0x00}, // Z
};

// 模拟I2C微秒延时 (基于12MHz晶振)
static void IIC_Delay(void) {
    _nop_(); _nop_(); _nop_(); _nop_();
}

// I2C起始信号
static void I2C_Start(void) {
    OLED_SDA = 1;
    OLED_SCL = 1;
    IIC_Delay();
    OLED_SDA = 0;
    IIC_Delay();
    OLED_SCL = 0;
    IIC_Delay();
}

// I2C停止信号
static void I2C_Stop(void) {
    OLED_SDA = 0;
    OLED_SCL = 1;
    IIC_Delay();
    OLED_SDA = 1;
    IIC_Delay();
}

// I2C等待应答
static unsigned char I2C_WaitAck(void) {
    unsigned char ack;
    OLED_SDA = 1; // 释放SDA
    IIC_Delay();
    OLED_SCL = 1;
    IIC_Delay();
    ack = OLED_SDA; // 读取应答信号
    OLED_SCL = 0;
    IIC_Delay();
    return ack;
}

// I2C发送一个字节
static void I2C_SendByte(unsigned char byte) {
    unsigned char i;
    for (i = 0; i < 8; i++) {
        OLED_SDA = (byte & 0x80) ? 1 : 0;
        IIC_Delay();
        OLED_SCL = 1;
        IIC_Delay();
        OLED_SCL = 0;
        byte <<= 1;
    }
}

// 写命令
static void OLED_WriteCmd(unsigned char cmd) {
    I2C_Start();
    I2C_SendByte(0x78);    // 从机地址 + 写标志
    I2C_WaitAck();
    I2C_SendByte(0x00);    // 控制字节，表示后面是命令
    I2C_WaitAck();
    I2C_SendByte(cmd);     // 命令数据
    I2C_WaitAck();
    I2C_Stop();
}

// 写数据
static void OLED_WriteDat(unsigned char dat) {
    I2C_Start();
    I2C_SendByte(0x78);    // 从机地址 + 写标志
    I2C_WaitAck();
    I2C_SendByte(0x40);    // 控制字节，表示后面是数据
    I2C_WaitAck();
    I2C_SendByte(dat);     // 显示数据
    I2C_WaitAck();
    I2C_Stop();
}

// 设置显示位置 (x: 0-127, y: 0-7 代表页)
static void OLED_SetPos(unsigned char x, unsigned char y) {
    OLED_WriteCmd(0xB0 + y);             // 设置页地址
    OLED_WriteCmd(((x & 0xF0) >> 4) | 0x10); // 设置列高4位
    OLED_WriteCmd((x & 0x0F) | 0x00);        // 设置列低4位
}

// 清屏
void OLED_Clear(void) {
    unsigned char i, n;
    for (i = 0; i < 8; i++) {
        OLED_WriteCmd(0xB0 + i);
        OLED_WriteCmd(0x00); // 【关键修复】列地址低4位必须为0
        OLED_WriteCmd(0x10);
        for (n = 0; n < 128; n++) {
            OLED_WriteDat(0);
        }
    }
}

// 显示单个字符 (6x8字体)
// x: 0-122, y: 0-7
void OLED_ShowChar(unsigned char x, unsigned char y, unsigned char chr) {
    unsigned char c = 0, i;
    c = chr - ' '; // 获取偏移量
    if (x > 122) { x = 0; y++; } 
    OLED_SetPos(x, y);
    for (i = 0; i < 6; i++) {
        OLED_WriteDat(F6x8[c][i]);
    }
}

// 显示字符串
void OLED_ShowString(unsigned char x, unsigned char y, const unsigned char code *chr) {
    unsigned char j = 0;
    while (chr[j] != '\0') {
        OLED_ShowChar(x, y, chr[j]);
        x += 6; 
        if (x > 122) { x = 0; y++; }
        j++;
    }
}

// OLED初始化
void OLED_Init(void) {
    // 增加上电延时，等待OLED内部复位完成
    unsigned char i, j;
    for(i = 0; i < 200; i++)
        for(j = 0; j < 200; j++);
    
    OLED_WriteCmd(0xAE); // 关闭显示
    
    OLED_WriteCmd(0xD5); // 设置时钟分频因子
    OLED_WriteCmd(0x80);
    
    OLED_WriteCmd(0xA8); // 设置驱动路数
    OLED_WriteCmd(0x3F);
    
    OLED_WriteCmd(0xD3); // 设置显示偏移
    OLED_WriteCmd(0x00);
    
    OLED_WriteCmd(0x40); // 设置起始行
    
    OLED_WriteCmd(0x8D); // 电荷泵设置
    OLED_WriteCmd(0x14);
    
    OLED_WriteCmd(0x20); // 设置内存地址模式
    OLED_WriteCmd(0x02); // 【关键】页地址模式 (0x02)，之前是0x00，可能不对
    
    OLED_WriteCmd(0xA1); // 段重定向 (A1正常，A0左右反转)
    
    OLED_WriteCmd(0xC8); // 设置COM扫描方向 (C8从下往上，C0从上往下)
    
    OLED_WriteCmd(0xDA); // 设置COM硬件引脚配置
    OLED_WriteCmd(0x12); // 【关键】COM引脚配置 (0x12)
    
    OLED_WriteCmd(0x81); // 对比度设置
    OLED_WriteCmd(0xCF); // 对比度值
    
    OLED_WriteCmd(0xD9); // 设置预充电周期
    OLED_WriteCmd(0xF1); // 预充电值
    
    OLED_WriteCmd(0xDB); // 设置VCOMH电压倍率
    OLED_WriteCmd(0x40); // VCOMH值
    
    OLED_WriteCmd(0xA4); // 全局显示开启
    
    OLED_WriteCmd(0xA6); // 设置显示方式 (A6正常，A7反色)
    
    OLED_WriteCmd(0xAF); // 开启显示
    
    OLED_Clear();
}
